const int groundPin = 7;
const int buzzPin = 9;

float frequency[113] = {
    659.3, 659.3,   0.0, 659.3,   0.0, 523.3, 659.3,   0.0, 784.0,   0.0, 392.0,
    0.0,   523.3,   0.0, 392.0,   0.0, 329.6,   0.0, 440.0,   0.0, 493.9,   0.0,
    466.2, 440.0,   0.0, 392.0, 659.3, 784.0, 880.0,   0.0, 698.5, 784.0,   0.0,
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    587.3,   0.0, 523.3};
unsigned int duration[113] =  {
      160,   160,   160,   160,   160,   160,   160,   160,   160,   480,   160,
      480,   160,   320,   260,   320,   160,   320,   160,   160,   160,   160,
      160,   160,   160,   240,   240,   240,   160,   160,   160,   160,   160,
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      160,   320,   160};

void buzz(float F, float D){
    if(F==0){
        delay(D);
    } else {
        int T = 1000000/F;
        int T1 = T/2;
        int T2 = T-T1;
        int R = (D/T)*1000;
        int L = (1000*D) - (T*R);
        for(int i=0; i<R; i++){
            digitalWrite(buzzPin, HIGH);
            delayMicroseconds(T1);
            digitalWrite(buzzPin, LOW);
            delayMicroseconds(T2);
        }
        delayMicroseconds(L);
    }
    delay(5);
}

void setup(){
    pinMode(groundPin, OUTPUT);
    pinMode(buzzPin, OUTPUT);
    pinMode(13, OUTPUT);
    digitalWrite(groundPin, LOW);
    bool state = true;
    for(int i=0; i<113; i++){
        digitalWrite(13, state);
        state = !state;
        buzz(frequency[i], duration[i]);
    }
}

void loop(){}